## config/west.yml
```yaml
manifest:
  remotes:
    - name: zmkfirmware
      url-base: https://github.com/zmkfirmware
    - name: badjeff
      url-base: https://github.com/badjeff
    - name: carrefinho                            
      url-base: https://github.com/carrefinho     
  projects:
    - name: zmk
      remote: zmkfirmware
      revision: 4ec69cb7e658590adf6354027aca789b364a70c5
      import: app/west.yml
    - name: zmk-pmw3610-driver
      remote: badjeff
      revision: 77635bad95097e2ed6fc16624622cff025a0e33b
    - name: prospector-zmk-module                 
      remote: carrefinho                          
      revision: 67425b7a3481683c05b1c0f88e8c0d071d036b91                       
  self:
    path: config
```
